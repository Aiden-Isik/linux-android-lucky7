## drivers/vibrator/hideep/ist207w/Kconfig
```kconfig
#
# motor drivers configuration
#

config VIB_DRV_ist207w
	tristate "IST207W motor"
	default n
	depends on I2C
	help
	 Say Y to enable the ist207w motor driver
```

## drivers/video/fbdev/samsung/panel/s6e36w5x01/Kconfig
```kconfig
menuconfig USDM_PANEL_S6E36W5X01
	tristate "S6E36W5X01 DDI Panel Driver"
	depends on USDM_PANEL
	depends on USDM_PANEL_OLED_COMMON
	default n
	help
		This enables S6E36W5X01 DDI dependent panel drivers of
		common panel driver. say Y, if you have a panel based on
		the S6E36W5X01 DDI.

########## FOR KUNIT ##########

config S6E36W5X01_TEST
	bool "KUnit test for lx83805 and lx83806 ddi driver"
	depends on SEC_KUNIT
	help
	  TODO: Describe config fully.



########## FOR KUNIT ##########

config S6E36W5X01_WATCH_FE_SMALL_TEST
	bool "KUnit test for tft_common ddi driver"
	depends on SEC_KUNIT
	help
	  TODO: Describe config fully.
```
